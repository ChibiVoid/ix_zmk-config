#include "corne_xiao_v1.dtsi"

/ {
    chosen {
        zmk,battery = &vbatt;
    };
};

&kscan0 {
    col-gpios
        = <&xiao_d 0 GPIO_ACTIVE_HIGH>
        , <&xiao_d 1 GPIO_ACTIVE_HIGH>
        , <&xiao_d 2 GPIO_ACTIVE_HIGH>
        , <&xiao_d 3 GPIO_ACTIVE_HIGH>
        , <&xiao_d 4 GPIO_ACTIVE_HIGH>
        , <&xiao_d 5 GPIO_ACTIVE_HIGH>
        ;
};

&vbatt {
    /* XIAO の READ_BAT (P0.14) を Low にして計測を有効化 */
    power-gpios = <&gpio0 14 GPIO_ACTIVE_LOW>;
    /* スイッチ付き分圧の立ち上がり待ち (値が低く出るのを防ぐ) */
    power-on-sample-delay-us = <5000>;
    /* XIAO nRF52840 の公式分圧値: 上側 1MΩ, 下側 510kΩ */
    output-ohms = <510000>;   // 下側抵抗 510kΩ
    full-ohms = <1510000>;    // 合計 = 1M + 510k (実電圧＝報告電圧)
};